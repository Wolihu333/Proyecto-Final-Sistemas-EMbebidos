#include <Wire.h>
#include <Adafruit_GFX.h>
#include <Adafruit_SSD1306.h>
#include <Adafruit_BMP280.h>
#include <ArduinoJson.h>
#include <WiFi.h>
#include <HTTPClient.h>

// Credenciales de red
const char SSID[64] = "IZZI-AA34";
const char PSWD[64] = "JPzFz2KL49merMMyrT";

// Servidor de ThingSpeak
String ServerLink = "https://api.thingspeak.com/update";
String apiKey = "J85YCOIHI5CDSXEM";

// Dimensiones OLED
#define SCREEN_WIDTH 128
#define SCREEN_HEIGHT 64
#define OLED_RESET    -1  // No usamos pin de reset físico

// Objeto pantalla OLED
Adafruit_SSD1306 display(SCREEN_WIDTH, SCREEN_HEIGHT, &Wire, OLED_RESET);

// Objeto sensor BMP280 (dirección I2C 0x76 por defecto)
Adafruit_BMP280 bmp;    

// Presión de referencia a nivel del mar en hPa
#define SEALEVELPRESSURE_HPA 1026 
// 1013.25 Estandar, 1026 en Chihuahua Capital

// Display de entrada
const unsigned char ImageSetUp [] PROGMEM = {
	0x00, 0x00, 0x00, 0x00, 0xff, 0xff, 0xff, 0xff, 0xff, 0xff, 0xff, 0xff, 0x00, 0x00, 0x00, 0x00, 
	0x00, 0x00, 0x00, 0x00, 0xff, 0xff, 0xff, 0xff, 0xff, 0xff, 0xff, 0xff, 0x00, 0x00, 0x00, 0x00, 
	0x00, 0x00, 0x00, 0x00, 0xff, 0xff, 0xff, 0xff, 0xff, 0xff, 0xff, 0xff, 0x00, 0x00, 0x00, 0x00, 
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	0x00, 0x00, 0x00, 0x00, 0xff, 0xff, 0xff, 0xff, 0xff, 0xff, 0xff, 0xff, 0x00, 0x00, 0x00, 0x00
};

void setup() {
  Serial.begin(115200);
  delay(100);

  // 1) Inicia bus I2C  
  Wire.begin();  // SDA=21, SCL=22

  // 2) Inicializa OLED  
  if (!display.begin(SSD1306_SWITCHCAPVCC, 0x3C)) {
    Serial.println("ERROR: OLED no detectada");
    while (true) delay(1000);
  }
  display.clearDisplay();
  display.drawBitmap(0, 0, ImageSetUp, SCREEN_WIDTH, SCREEN_HEIGHT, WHITE);
  display.display();

  // 3) Inicializa BMP280  
  if (!bmp.begin(0x76)) {
    Serial.println("ERROR: BMP280 no detectado en 0x76");
    // Prueba en 0x77 si tu módulo lo requiere:
    if (!bmp.begin(0x77)) {
      Serial.println("ERROR: BMP280 no en 0x77 tampoco");
      while (true) delay(1000);
    }
  }
  Serial.println("BMP280 listo");

  // 4) Iniciazion de conexcion Wifi
  vTaskDelay( pdMS_TO_TICKS( 500 ) );
  WiFi.begin(SSID, PSWD);
  Serial.print("Wacha loco, ya pesco tu chingadera!!\n"); //Conectado al WiFi
  while (WiFi.status() != WL_CONNECTED){
    vTaskDelay( pdMS_TO_TICKS( 500 ) );
    Serial.print(".");
  }
  Serial.println("\nLa Base de Virus ha sido Actualizada");
}

void loop() {
  if (WiFi.status()== WL_CONNECTED)
  {
    HTTPClient http;

    // Lecturas del sensor
    float temp      = bmp.readTemperature();                    // °C
    float pres_hpa  = bmp.readPressure() / 100.0F;              // hPa
    float altitude  = bmp.readAltitude(SEALEVELPRESSURE_HPA);   // m

    // Muestra en OLED
    display.clearDisplay();
    display.setTextSize(1);
    display.setTextColor(WHITE);

    display.setCursor(0, 0);
    display.printf("Temp: %.2f C\n", temp);
    display.setCursor(0, 13);
    display.printf("Pres: %.2f hPa\n", pres_hpa);
    display.setCursor(0, 29);
    display.printf("Alt : %.2f m\n", altitude);

    display.setCursor(0, 44);
    display.printf("Y. Diaz 24190009");
    display.setCursor(0, 54);
    display.printf("R. Perez 24190007");

    display.display();

    // Envio de datos a diferentes puertos para su apreciacion
    String url = ServerLink + "?api_key=" + apiKey;
    url +="&field1=" + String(temp);
    url +="&field2=" + String(pres_hpa);
    url +="&field3=" + String(altitude);

    // Visualizacion en el Monitor Serial de los datos enviados
    http.begin(url);
    int httpCode = http.GET();
    if(httpCode > 0 )
    {
      Serial.println("Datos enviados  " + String(httpCode));
      Serial.println(" Temperatura:         " + String(temp));
      Serial.println(" Presion Atmosferica: " + String(pres_hpa));
      Serial.println(" Altitud aproximada:  " + String(altitude));

    }
    else
    {
      Serial.println("Error al enviar");
    }

    http.end();
  }
  
  // Tiempo de espera, minimo 20 segundos por el servidor
  vTaskDelay( pdMS_TO_TICKS( 20000 ) );
}